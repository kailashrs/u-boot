## arch/arm/mach-s5l87xx/s5l8720/Kconfig
```kconfig
if S5L8720

choice
	prompt "S5L8720 board"
	default TARGET_N58S

config TARGET_N58S
	bool "Apple N58s - iPod nano (4th generation)"
	help
	  Apple iPod nano (4th generation) is a digital audio player, introduced in
	  September 2008. It has a NAND flash of either 8 or 16 GiB.

config TARGET_N72
	bool "Apple N72AP - iPod touch (2nd generation)"
	help
	  RAM-loaded U-Boot for the Apple iPod touch (2nd generation).

endchoice

source "board/apple/n58s/Kconfig"
source "board/apple/n72/Kconfig"

endif
```

## board/apple/n72/Kconfig
```kconfig
if TARGET_N72

config SYS_BOARD
	default "n72"

config SYS_VENDOR
	default "apple"

config SYS_SOC
	default "s5l8720"

config SYS_CONFIG_NAME
	default "apple_n72"

endif
```

## configs/apple_n72_debug_defconfig
```kconfig
CONFIG_ARM=y
CONFIG_SKIP_LOWLEVEL_INIT_ONLY=y
CONFIG_POSITION_INDEPENDENT=y
CONFIG_ARCH_S5L87XX=y
CONFIG_TEXT_BASE=0x0b000000
CONFIG_HAS_CUSTOM_SYS_INIT_SP_ADDR=y
CONFIG_CUSTOM_SYS_INIT_SP_ADDR=0x08400000
CONFIG_SYS_MALLOC_LEN=0x00200000
CONFIG_DEFAULT_DEVICE_TREE="s5l8720-n72"
CONFIG_S5L8720=y
CONFIG_TARGET_N72=y
CONFIG_SYS_LOAD_ADDR=0x09000000
CONFIG_DEBUG_UART_BASE=0x3cc00000
CONFIG_DEBUG_UART_CLOCK=24000000
CONFIG_DEBUG_UART_BOARD_INIT=y
CONFIG_DEBUG_UART=y
CONFIG_STACK_SIZE=0x00100000
CONFIG_BOOTDELAY=0
CONFIG_USE_BOOTCOMMAND=y
CONFIG_BOOTCOMMAND="dfu 0 ram 0; if iminfo 0x09000000; then echo n72: bootm start; bootm start 0x09000000 && echo n72: loados && bootm loados && echo n72: ramdisk && bootm ramdisk && echo n72: fdt && bootm fdt && echo n72: prep && bootm prep && echo n72: ready, detach again to start the kernel && dfu 0 ram 0 && echo n72: go && bootm go; echo n72: bootm stopped; dfu 0 ram 0; else dcache off; icache off; go 0x09000000; fi"
# CONFIG_BOOTSTD is not set
CONFIG_BOARD_EARLY_INIT_F=y
CONFIG_CMD_DFU=y
CONFIG_OF_CONTROL=y
CONFIG_ENV_IS_NOWHERE=y
CONFIG_CLK=y
CONFIG_DFU_RAM=y
CONFIG_SET_DFU_ALT_INFO=y
CONFIG_SYS_DFU_DATA_BUF_SIZE=0x00100000
CONFIG_DEBUG_UART_ANNOUNCE=y
CONFIG_USB=y
CONFIG_DM_USB_GADGET=y
CONFIG_USB_GADGET=y
CONFIG_USB_GADGET_MANUFACTURER="U-Boot N72AP"
CONFIG_USB_GADGET_VENDOR_NUM=0x05ac
CONFIG_USB_GADGET_PRODUCT_NUM=0xff00
CONFIG_USB_GADGET_DWC2_OTG=y
CONFIG_USB_GADGET_DOWNLOAD=y
CONFIG_CMD_CACHE=y
CONFIG_CONSOLE_RECORD=y
CONFIG_CONSOLE_RECORD_OUT_SIZE=0x10000
CONFIG_USB_GADGET_DWC2_OTG_CTRL_UNCACHED_ADDR=0x0a000000
CONFIG_VIDEO=y
CONFIG_VIDEO_BPP32=y
CONFIG_SYS_WHITE_ON_BLACK=y
CONFIG_CONSOLE_MUX=y
CONFIG_ENV_SOURCE_FILE="n72"
CONFIG_FIT=y
CONFIG_CMD_BOOTM=y
CONFIG_CMD_IMI=y
# CONFIG_ARCH_FIXUP_FDT_MEMORY is not set
CONFIG_HUSH_PARSER=y
```
